## firmware/main/Kconfig.projbuild
```kconfig
menu "MS2109 wireless display"
    config CAPTURE_AUDIO
        bool "Capture MS2109 HDMI audio"
        default y
    config CAPTURE_AUDIO_SPEAKER
        bool "Play HDMI audio through the Korvo speaker codec"
        depends on CAPTURE_AUDIO
        default y
    config CAPTURE_AUDIO_VOLUME
        int "Initial device speaker volume (%)"
        default 35
        range 0 100
    config CAPTURE_LOG_KB
        int "Recent browser log buffer (KiB)"
        default 16
        range 4 64
    config CAPTURE_STREAM_SEND_MS
        int "Maximum MJPEG frame send time (ms)"
        default 250
        range 100 2000
        help
            Disconnect stalled stream clients rather than accumulating old video.
            Use a lower capture resolution if the link cannot sustain this budget.
    choice CAPTURE_PROFILE
        prompt "Capture profile"
        default CAPTURE_PROFILE_HD
        config CAPTURE_PROFILE_HD
            bool "1280x720 MJPEG at 30 fps (widescreen HDMI)"
        config CAPTURE_PROFILE_VGA
            bool "640x480 MJPEG at 30 fps (4:3 source)"
        config CAPTURE_PROFILE_CUSTOM
            bool "Custom advertised mode"
    endchoice
    config CAPTURE_WIDTH
        int "UVC capture width"
        depends on CAPTURE_PROFILE_CUSTOM
        default 640
        range 160 1280
    config CAPTURE_HEIGHT
        int "UVC capture height"
        depends on CAPTURE_PROFILE_CUSTOM
        default 480
        range 120 720
    config CAPTURE_FPS
        int "Capture FPS (0 uses card default)"
        depends on CAPTURE_PROFILE_CUSTOM
        default 0
        range 0 60
    config CAPTURE_FRAME_KB
        int "Maximum compressed frame size (KiB)"
        default 512
        range 128 2048
    config CAPTURE_VID
        hex "USB vendor ID (0 accepts any UVC device)"
        default 0x0
    config CAPTURE_PID
        hex "USB product ID (0 accepts any UVC device)"
        default 0x0
    config CAPTURE_MS2109_HEADERS
        bool "Strip MS2109 continuation headers for known MS2109 IDs"
        default y
        help
            Applies only to 534d:2109 and 345f:2109 MJPEG devices using
            16384-byte bulk URBs. See components/usb_host_uvc/PATCHES.md.
endmenu
```

## firmware/sdkconfig.defaults
```kconfig
CONFIG_IDF_TARGET="esp32s31"
CONFIG_ESPTOOLPY_FLASHMODE_QIO=y
CONFIG_ESPTOOLPY_FLASHSIZE_16MB=y
CONFIG_PARTITION_TABLE_CUSTOM=y
CONFIG_PARTITION_TABLE_CUSTOM_FILENAME="partitions.csv"
CONFIG_COMPILER_OPTIMIZATION_PERF=y
CONFIG_SPIRAM=y
CONFIG_SPIRAM_SPEED_250M=y
CONFIG_SPIRAM_XIP_FROM_PSRAM=y
CONFIG_SPIRAM_TRY_ALLOCATE_WIFI_LWIP=y
CONFIG_SPIRAM_MALLOC_RESERVE_INTERNAL=65536
CONFIG_FREERTOS_HZ=1000
CONFIG_LWIP_MAX_SOCKETS=16
CONFIG_ESP_MAIN_TASK_STACK_SIZE=8192
CONFIG_LV_COLOR_DEPTH_16=y
CONFIG_LV_USE_CLIB_MALLOC=y
CONFIG_LV_USE_CLIB_STRING=y
CONFIG_LV_USE_CLIB_SPRINTF=y
CONFIG_LV_CACHE_DEF_SIZE=0
CONFIG_LV_FONT_MONTSERRAT_18=y
CONFIG_LV_DEF_REFR_PERIOD=33
CONFIG_BSP_LCD_DRAW_BUF_HEIGHT=60
CONFIG_BSP_LCD_RGB_BUFFER_NUMS=2
CONFIG_BSP_DISPLAY_LVGL_AVOID_TEAR=y
CONFIG_BSP_DISPLAY_LVGL_FULL_REFRESH=y
CONFIG_UVC_INTERVAL_ARRAY_SIZE=16
CONFIG_USB_HOST_CONTROL_TRANSFER_MAX_SIZE=4096
```
